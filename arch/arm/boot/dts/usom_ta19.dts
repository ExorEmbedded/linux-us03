/*
 * Copyright (C) 2020 Exor S.p.a
 * 
 * Written by: G. Pavoni Exor S.p.a. (starting from the usom_be15a.dts file)
 * 
 * Copyright (C) 2013 Freescale Semiconductor, Inc.
 *
 * This program is free software; you can redistribute it and/or modify
 * it under the terms of the GNU General Public License version 2 as
 * published by the Free Software Foundation.
 */

/dts-v1/;

#include "imx6q.dtsi"
#include "usom_ta19.dtsi"

/ {
	model = "TA19 i.MX6 Board";
	compatible = "fsl,imx6q-sabresd", "fsl,imx6q";
};